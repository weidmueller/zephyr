## soc/arm/xilinx_zynqmp/Kconfig.soc
```kconfig
# Copyright (c) 2019 Lexmark International, Inc.
# Copyright (c) 2019 Stephanos Ioannidis <root@stephanos.io>
# Copyright (c) 2020 Weidmueller Interface GmbH & Co. KG
# SPDX-License-Identifier: Apache-2.0

config SOC_XILINX_ZYNQMP_RPU
	bool "Xilinx ZynqMP RPU"
	select ARM
	select CPU_CORTEX_R5
	select SOC_XILINX_ZYNQMP
	select GIC_V1
	select PLATFORM_SPECIFIC_INIT

config ZYNQMP_PS_REF_FREQUENCY
	depends on SOC_XILINX_ZYNQMP_RPU
	int "Processor system reference clock (Hz)"
	default 50000000
	help
	  PS reference clock frequency, to be obtained from the Zynq 
	  UltraScale+ summary report.

config ZYNQMP_APLL_MULTIPLIER
	depends on SOC_XILINX_ZYNQMP_RPU
	int "APU PLL (APLL) reference frequency multiplier"
	default 48
	help
	  The multiplier applied to the PS reference clock by the APU PLL.

config ZYNQMP_DPLL_MULTIPLIER
	depends on SOC_XILINX_ZYNQMP_RPU
	int "DDR PLL (DPLL) reference frequency multiplier"
	default 48
	help
	  The multiplier applied to the PS reference clock by the DDR PLL.

config ZYNQMP_IOPLL_MULTIPLIER
	depends on SOC_XILINX_ZYNQMP_RPU
	int "I/O PLL reference frequency multiplier"
	default 60
	help
	  The multiplier applied to the PS reference clock by the I/O PLL.

config ZYNQMP_RPLL_MULTIPLIER
	depends on SOC_XILINX_ZYNQMP_RPU
	int "RPU PLL (RPLL) reference frequency multiplier"
	default 32
	help
	  The multiplier applied to the PS reference clock by the RPU PLL.

config ZYNQMP_VPLL_MULTIPLIER
	depends on SOC_XILINX_ZYNQMP_RPU
	int "Video PLL (VPLL) reference frequency multiplier"
	default 42
	help
	  The multiplier applied to the PS reference clock by the Video PLL.

######################################################################################
# CLOCK CONFIGURATION OF I/O PERIPHERALS                                             #
######################################################################################

###### LPD LSBUS ######

menu "LPD LSBUS clock configuration"
	depends on SOC_XILINX_ZYNQMP_RPU

choice
	prompt "LPD LSBUS clock source"
	depends on SOC_XILINX_ZYNQMP_RPU
	help
	  Configures the source of the LPD LSBUS clock.

config ZYNQMP_LPD_LSBUS_REFCLK_RPLL
	bool "RPU PLL"
	help
	  LPD LSBUS clock source is the RPU PLL.

config ZYNQMP_LPD_LSBUS_REFCLK_IOPLL
	bool "I/O PLL"
	help
	  LPD LSBUS clock source is the I/O PLL.

config ZYNQMP_LPD_LSBUS_REFCLK_DPLL
	bool "DDR PLL (from FPD)"
	help
	  LPD LSBUS clock source is the DDR PLL from the full-power domain.

endchoice

config ZYNQMP_LPD_LSBUS_DIVISOR0
	depends on SOC_XILINX_ZYNQMP_RPU
	int "LPD LSBUS reference frequency divisor"
	default 24
	help
	  The divisor applied to the LPD LSBUS reference clock.

endmenu

###### ENET0 ######

menu "ENET0 clock configuration"
	depends on SOC_XILINX_ZYNQMP_RPU

choice
	prompt "Reference clock source"
	depends on SOC_XILINX_ZYNQMP_RPU
	help
	  Configures the source of the reference clock.

config ZYNQMP_ENET0_REFCLK_PLL
	bool "PLL reference clock"
	help
	  Signal source is the PLL reference clock.

config ZYNQMP_ENET0_REFCLK_EMIO_GTX
	bool "EMIO PLL clock or GTX clock"
	help
	  Signal source is the EMIO PLL clock or GTX clock.

endchoice

choice
	prompt "RX clock source"
	depends on SOC_XILINX_ZYNQMP_RPU
	help
	  Configures the source for the RX clock.

config ZYNQMP_ENET0_RXCLK_MIO
	bool "MIO"
	help
	  Signal source is MIO.

config ZYNQMP_ENET0_RXCLK_EMIO
	bool "EMIO"
	help
	  Signal source is EMIO.

endchoice

choice
	prompt "Controller reference clock source PLL"
	depends on SOC_XILINX_ZYNQMP_RPU
	help
	  Configures the source of the reference clock to be used by GEM0.

config ZYNQMP_ENET0_REFCLK_IOPLL
	bool "I/O PLL"
	help
	  Reference clock source is the I/O PLL.

config ZYNQMP_ENET0_REFCLK_RPLL
	bool "RPU PLL"
	help
	  Reference clock source is the RPU PLL.

config ZYNQMP_ENET0_REFCLK_DPLL
	bool "DDR PLL (from FPD)"
	help
	  Reference clock source is the DDR PLL from the full-power domain.

endchoice

config ZYNQMP_ENET0_DIVISOR0
	depends on SOC_XILINX_ZYNQMP_RPU
	int "Reference PLL divisor 0 for ENET0 clock generation - set to 0 for auto-detection"
	default 0
	help
	  The first divisor applied to the output clock of the reference PLL based on which the ENET0
	  clock signal is generated. If this value is set to 0, this value will be auto-detected
	  based on the link speed selected in the GEM driver's configuration settings. Manual
	  configuration of this parameter is only required when using the external EMIO clock.

config ZYNQMP_ENET0_DIVISOR1
	depends on SOC_XILINX_ZYNQMP_RPU
	int "Reference PLL divisor 1 for ENET0 clock generation - set to 0 for auto-detection"
	default 0
	help
	  The second divisor applied to the output clock of the reference PLL based on which the ENET0
	  clock signal is generated. If this value is set to 0, this value will be auto-detected
	  based on the link speed selected in the GEM driver's configuration settings. Manual
	  configuration of this parameter is only required when using the external EMIO clock.

endmenu

###### ENET1 ######

menu "ENET1 clock configuration"
	depends on SOC_XILINX_ZYNQMP_RPU

choice
	prompt "Reference clock source"
	depends on SOC_XILINX_ZYNQMP_RPU
	help
	  Configures the source of the reference clock.

config ZYNQMP_ENET1_REFCLK_PLL
	bool "PLL reference clock"
	help
	  Signal source is the PLL reference clock.

config ZYNQMP_ENET1_REFCLK_EMIO_GTX
	bool "EMIO PLL clock or GTX clock"
	help
	  Signal source is the EMIO PLL clock or GTX clock.

endchoice

choice
	prompt "RX clock source"
	depends on SOC_XILINX_ZYNQMP_RPU
	help
	  Configures the source for the RX clock.

config ZYNQMP_ENET1_RXCLK_MIO
	bool "MIO"
	help
	  Signal source is MIO.

config ZYNQMP_ENET1_RXCLK_EMIO
	bool "EMIO"
	help
	  Signal source is EMIO.

endchoice

choice
	prompt "Controller reference clock source PLL"
	depends on SOC_XILINX_ZYNQMP_RPU
	help
	  Configures the source of the reference clock to be used by GEM1.

config ZYNQMP_ENET1_REFCLK_IOPLL
	bool "I/O PLL"
	help
	  Reference clock source is the I/O PLL.

config ZYNQMP_ENET1_REFCLK_RPLL
	bool "RPU PLL"
	help
	  Reference clock source is the RPU PLL.

config ZYNQMP_ENET1_REFCLK_DPLL
	bool "DDR PLL (from FPD)"
	help
	  Reference clock source is the DDR PLL from the full-power domain.

endchoice

config ZYNQMP_ENET1_DIVISOR0
	depends on SOC_XILINX_ZYNQMP_RPU
	int "Reference PLL divisor 0 for ENET1 clock generation - set to 0 for auto-detection"
	default 0
	help
	  The first divisor applied to the output clock of the reference PLL based on which the ENET1
	  clock signal is generated. If this value is set to 0, this value will be auto-detected
	  based on the link speed selected in the GEM driver's configuration settings. Manual
	  configuration of this parameter is only required when using the external EMIO clock.

config ZYNQMP_ENET1_DIVISOR1
	depends on SOC_XILINX_ZYNQMP_RPU
	int "Reference PLL divisor 1 for ENET1 clock generation - set to 0 for auto-detection"
	default 0
	help
	  The second divisor applied to the output clock of the reference PLL based on which the ENET1
	  clock signal is generated. If this value is set to 0, this value will be auto-detected
	  based on the link speed selected in the GEM driver's configuration settings. Manual
	  configuration of this parameter is only required when using the external EMIO clock.

endmenu

###### ENET2 ######

menu "ENET2 clock configuration"
	depends on SOC_XILINX_ZYNQMP_RPU

choice
	prompt "Reference clock source"
	depends on SOC_XILINX_ZYNQMP_RPU
	help
	  Configures the source of the reference clock.

config ZYNQMP_ENET2_REFCLK_PLL
	bool "PLL reference clock"
	help
	  Signal source is the PLL reference clock.

config ZYNQMP_ENET2_REFCLK_EMIO_GTX
	bool "EMIO PLL clock or GTX clock"
	help
	  Signal source is the EMIO PLL clock or GTX clock.

endchoice

choice
	prompt "RX clock source"
	depends on SOC_XILINX_ZYNQMP_RPU
	help
	  Configures the source for the RX clock.

config ZYNQMP_ENET2_RXCLK_MIO
	bool "MIO"
	help
	  Signal source is MIO.

config ZYNQMP_ENET2_RXCLK_EMIO
	bool "EMIO"
	help
	  Signal source is EMIO.

endchoice

choice
	prompt "Controller reference clock source PLL"
	depends on SOC_XILINX_ZYNQMP_RPU
	help
	  Configures the source of the reference clock to be used by GEM2.

config ZYNQMP_ENET2_REFCLK_IOPLL
	bool "I/O PLL"
	help
	  Reference clock source is the I/O PLL.

config ZYNQMP_ENET2_REFCLK_RPLL
	bool "RPU PLL"
	help
	  Reference clock source is the RPU PLL.

config ZYNQMP_ENET2_REFCLK_DPLL
	bool "DDR PLL (from FPD)"
	help
	  Reference clock source is the DDR PLL from the full-power domain.

endchoice

config ZYNQMP_ENET2_DIVISOR0
	depends on SOC_XILINX_ZYNQMP_RPU
	int "Reference PLL divisor 0 for ENET2 clock generation - set to 0 for auto-detection"
	default 0
	help
	  The first divisor applied to the output clock of the reference PLL based on which the ENET2
	  clock signal is generated. If this value is set to 0, this value will be auto-detected
	  based on the link speed selected in the GEM driver's configuration settings. Manual
	  configuration of this parameter is only required when using the external EMIO clock.

config ZYNQMP_ENET2_DIVISOR1
	depends on SOC_XILINX_ZYNQMP_RPU
	int "Reference PLL divisor 1 for ENET2 clock generation - set to 0 for auto-detection"
	default 0
	help
	  The second divisor applied to the output clock of the reference PLL based on which the ENET2
	  clock signal is generated. If this value is set to 0, this value will be auto-detected
	  based on the link speed selected in the GEM driver's configuration settings. Manual
	  configuration of this parameter is only required when using the external EMIO clock.

endmenu

###### ENET3 ######

menu "ENET3 clock configuration"
	depends on SOC_XILINX_ZYNQMP_RPU

choice
	prompt "Reference clock source"
	depends on SOC_XILINX_ZYNQMP_RPU
	help
	  Configures the source of the reference clock.

config ZYNQMP_ENET3_REFCLK_PLL
	bool "PLL reference clock"
	help
	  Signal source is the PLL reference clock.

config ZYNQMP_ENET3_REFCLK_EMIO_GTX
	bool "EMIO PLL clock or GTX clock"
	help
	  Signal source is the EMIO PLL clock or GTX clock.

endchoice

choice
	prompt "RX clock source"
	depends on SOC_XILINX_ZYNQMP_RPU
	help
	  Configures the source for the RX clock.

config ZYNQMP_ENET3_RXCLK_MIO
	bool "MIO"
	help
	  Signal source is MIO.

config ZYNQMP_ENET3_RXCLK_EMIO
	bool "EMIO"
	help
	  Signal source is EMIO.

endchoice

choice
	prompt "Controller reference clock source PLL"
	depends on SOC_XILINX_ZYNQMP_RPU
	help
	  Configures the source of the reference clock to be used by GEM3.

config ZYNQMP_ENET3_REFCLK_IOPLL
	bool "I/O PLL"
	help
	  Reference clock source is the I/O PLL.

config ZYNQMP_ENET3_REFCLK_RPLL
	bool "RPU PLL"
	help
	  Reference clock source is the RPU PLL.

config ZYNQMP_ENET3_REFCLK_DPLL
	bool "DDR PLL (from FPD)"
	help
	  Reference clock source is the DDR PLL from the full-power domain.

endchoice

config ZYNQMP_ENET3_DIVISOR0
	depends on SOC_XILINX_ZYNQMP_RPU
	int "Reference PLL divisor 0 for ENET3 clock generation - set to 0 for auto-detection"
	default 0
	help
	  The first divisor applied to the output clock of the reference PLL based on which the ENET3
	  clock signal is generated. If this value is set to 0, this value will be auto-detected
	  based on the link speed selected in the GEM driver's configuration settings. Manual
	  configuration of this parameter is only required when using the external EMIO clock.

config ZYNQMP_ENET3_DIVISOR1
	depends on SOC_XILINX_ZYNQMP_RPU
	int "Reference PLL divisor 1 for ENET3 clock generation - set to 0 for auto-detection"
	default 0
	help
	  The second divisor applied to the output clock of the reference PLL based on which the ENET3
	  clock signal is generated. If this value is set to 0, this value will be auto-detected
	  based on the link speed selected in the GEM driver's configuration settings. Manual
	  configuration of this parameter is only required when using the external EMIO clock.

endmenu
```
