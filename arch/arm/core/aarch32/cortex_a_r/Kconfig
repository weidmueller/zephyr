## dts/bindings/clock/xlnx,zynq7000-slcr.yaml
```yaml
#
# Copyright (c) 2020, Weidmueller Interface GmbH & Co. KG
# SPDX-License-Identifier: Apache-2.0
#

description: Xilinx Zynq-7000 System Level Control Registers (SLCR)

compatible: "xlnx,zynq7000-slcr"

include: [clock-controller.yaml, base.yaml]

properties:
    label:
      required: true

    reg:
      required: true

    ps-ref-clk-frequency:
      type: int
      description: Processor System reference clock frequency
      required: true

    clk-domain-mode:
      type: int
      description: Clock domain mode setting (6:3:2:1 or 4:2:2:1)
      required: true

    arm-pll-multiplier:
      type: int
      description: ARM PLL multiplier applied to the reference clock
      required: true

    ddr-pll-multiplier:
      type: int
      description: DDR PLL multiplier applied to the reference clock
      required: true

    io-pll-multiplier:
      type: int
      description: IO PLL multiplier applied to the reference clock
      required: true

    arm-pll-divisor0:
      type: int
      description: |
        Divisor 0 applied to ARM PLL clock for the generation of the
        cpu_2x and cpu_1x clock signals as well as cpu_6x4x if the clock
        domain mode is set to 6:3:2:1 or cpu_3x2x if the clock domain
        mode is set to 4:2:2:1.
      required: true

    ddr-pll-ddr3x-divisor0:
      type: int
      description: |
        Divisor 0 applied to DDR PLL clock for the generation of the
        ddr_3x clock signal.
      required: true

    ddr-pll-ddr2x-divisor0:
      type: int
      description: |
        Divisor 0 applied to DDR PLL clock for the generation of the
        ddr_2x clock signal.
      required: true

    ddr-pll-ddr-dci-divisor0:
      type: int
      description: |
        Divisor 0 applied to DDR PLL clock for the generation of the
        DDR DCI clock signal.
      required: true

    ddr-pll-ddr-dci-divisor1:
      type: int
      description: |
        Divisor 1 applied to DDR PLL clock for the generation of the
        DDR DCI clock signal.
      required: true

    gem0-rx-clk-source:
      type: int
      description: |
        Selects the source of the RX clock as well as the control and
        data signals for the GEM0 Ethernet controller.
      required: true

    gem0-ref-clk-source:
      type: int
      description: |
        Selects the reference clock source for the GEM0 Ethernet
        controller. The TX clock is derived from this clock source.
      required: true

    gem0-ref-clk-divisor0:
      type: int
      description: |
        First divisor applied to the GEM0 reference clock in order
        to generate the TX clock based on the reference clock. A
        fixed value can be specified here, limiting the controller
        to a specific link speed, or the device driver can calculate
        the divisors automatically upon a auto-negotiated link speed
        change. For auto-calculation by the driver, set both reference
        clock divisors to 0.
      required: true

    gem0-ref-clk-divisor1:
      type: int
      description: |
        Second divisor applied to the GEM0 reference clock in order
        to generate the TX clock based on the reference clock. A
        fixed value can be specified here, limiting the controller
        to a specific link speed, or the device driver can calculate
        the divisors automatically upon a auto-negotiated link speed
        change. For auto-calculation by the driver, set both reference
        clock divisors to 0.
      required: true

    gem1-rx-clk-source:
      type: int
      description: |
        Selects the source of the RX clock as well as the control and
        data signals for the GEM1 Ethernet controller.
      required: true

    gem1-ref-clk-source:
      type: int
      description: |
        Selects the reference clock source for the GEM1 Ethernet
        controller. The TX clock is derived from this clock source.
      required: true

    gem1-ref-clk-divisor0:
      type: int
      description: |
        First divisor applied to the GEM1 reference clock in order
        to generate the TX clock based on the reference clock. A
        fixed value can be specified here, limiting the controller
        to a specific link speed, or the device driver can calculate
        the divisors automatically upon a auto-negotiated link speed
        change. For auto-calculation by the driver, set both reference
        clock divisors to 0.
      required: true

    gem1-ref-clk-divisor1:
      type: int
      description: |
        Second divisor applied to the GEM1 reference clock in order
        to generate the TX clock based on the reference clock. A
        fixed value can be specified here, limiting the controller
        to a specific link speed, or the device driver can calculate
        the divisors automatically upon a auto-negotiated link speed
        change. For auto-calculation by the driver, set both reference
        clock divisors to 0.
      required: true

    uart-ref-clk-source:
      type: int
      description: |
        Selects the reference clock source for both UART controllers.
      required: true

    uart-ref-clk-divisor0:
      type: int
      description: |
        First divisor applied to the UART0/1 reference clock in order
        to generate the clock signal which will in turn be pre-scaled
        down so that the controllers operate at their respective target
        baud rates.
      required: true

    can-ref-clk-source:
      type: int
      description: |
        Selects the reference clock source for both CAN controllers.
      required: true

    can-ref-clk-divisor0:
      type: int
      description: |
        First divisor applied to the CAN0/1 reference clock in order
        to generate the clock signal which will in turn be pre-scaled
        down so that the controllers operate at their respective target
        bus speeds.
      required: true

    can-ref-clk-divisor1:
      type: int
      description: |
        Second divisor applied to the CAN0/1 reference clock in order
        to generate the clock signal which will in turn be pre-scaled
        down so that the controllers operate at their respective target
        bus speeds.
      required: true

    "#clock-cells":
      const: 1

clock-cells:
  - name
```

## dts/bindings/ethernet/xlnx,gem.yaml
```yaml
#
# Copyright (c) 2020, Weidmueller Interface GmbH & Co. KG
# SPDX-License-Identifier: Apache-2.0
#

description: Xilinx GEM Ethernet controller

compatible: "xlnx,gem"

include: ethernet.yaml

properties:
    reg:
      required: true

    interrupts:
      required: true

    clock-frequency:
      type: int
      required: true
      description: TX Clock base frequency
        Specifies the base clock frequency from which the GEM's TX clock
        frequency will be derived using two dividers in the respective GEM's
        clock control register in the SLCR. The GEM's TX clock frequency
        is determined by the current link speed reported by the PHY, to
        which it will be adjusted at run-time. Therefore, the value of this
        item must be set to the clock frequency of the PLL supplying the
        respective GEM's TX clock - by default, this is the IO PLL.

    clk-ctrl-reg:
      type: int
      required: true
      description: TX Clock frequency control register address
        The address of the respective GEM's TX clock control register
        (GEMx_REF_CTRL in the CRL_APB register space on ZynqMP).

    mdc-divider:
      type: int
      required: true
      description: The MDC clock divider for the respective GEM. This is the
        divider applied to the cpu_1x clock in order to derive MDIO interface
        clock driving communications with the attached PHY. Refer to the
        Zynq-7000 TRM (Xilinx document ID UG585), Appendix B, documentation of
        register XEMACPS_NWCFG, p. 1274 ff., bits 20:18 to determine the
        appropriate divider for the target's cpu_1x clock frequency.
```

## dts/bindings/gpio/xlnx,axi-gpio.yaml
```yaml
# Copyright (c) 2020, Weidmueller Interface GmbH & Co. KG
# SPDX-License-Identifier: Apache-2.0

description: Xilinx AXI GPIO node

compatible: "xlnx,axi-gpio"

include: [gpio-controller.yaml, base.yaml]

properties:
    reg:
      required: true

    label:
      required: true

    interrupts:
      required: true

    polling:
      type: boolean
      required: false
      description: |
        Indicates that the current instance doesn't have interrupt
        functionality activated in its respective IP core settings.

    "#gpio-cells":
      const: 2

gpio-cells:
  - pin
  - flags
```

## soc/arm/xilinx_zynq7000/Kconfig.soc
```kconfig
#
# Copyright (c) 2020 Weidmueller Interface GmbH & Co. KG
# SPDX-License-Identifier: Apache-2.0
#

menuconfig SOC_XILINX_ZYNQ7000
	bool "Xilinx Zynq-7000 (XC7Zxxx)"
	select ARM
	select CPU_CORTEX_A9
	select GIC_V1
	select ARM_ARCH_TIMER_ERRATUM_740657 if ARM_ARCH_TIMER
```
