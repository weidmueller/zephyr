## arch/arm/core/aarch32/cortex_a_r/Kconfig
```kconfig
# ARM Cortex-A and Cortex-R platform configuration options

# Copyright (c) 2018 Marvell
# Copyright (c) 2018 Lexmark International, Inc.
# Copyright (c) 2020 Weidmueller Interface GmbH & Co. KG
# SPDX-License-Identifier: Apache-2.0

# NOTE: We have the specific core implementations first and outside of the
# if CPU_CORTEX_A / if CPU_CORTEX_R block so that SoCs can select which core
# they are using without having to select all the options related to that 
# core. Everything else is captured inside the if if CPU_CORTEX_A / if 
# CPU_CORTEX_R blocks so they are not exposed if one selects a different ARM 
# Cortex Family (Cortex-M).

config CPU_CORTEX_A9
	bool
	select CPU_CORTEX_A
	select ARMV7_A
	select CPU_HAS_FPU_DOUBLE_PRECISION
	select CPU_HAS_ARM_MMU
	
	help
	  This option signifies the use of a Cortex-A9 CPU

if CPU_CORTEX_A

config ARMV7_A
	bool
	select ATOMIC_OPERATIONS_BUILTIN
	select ISA_ARM
	select ARMV7_A_MMU if CPU_HAS_ARM_MMU
	select ARMV7_A_FP if CPU_HAS_FPU_DOUBLE_PRECISION
	help
	  This option signifies the use of an ARMv7-A processor
	  implementation.

	  From https://developer.arm.com/products/architecture/cpu-architecture/a-profile:
	  The Armv7-A architecture implements a traditional Arm architecture with 
	  multiple modes, supports a Virtual Memory System Architecture (VMSA) 
	  based on a Memory Management Unit (MMU), and supports the Arm (A32) and 
	  Thumb (T32) instruction sets.

config ARMV7_A_FP
	bool
	depends on ARMV7_A
	help
	  This option signifies the use of an ARMv7-A processor implementation
	  supporting the VFPv3-D32 Floating-Point Extension.

config ARMV7_A_MMU
	bool
	depends on ARMV7_A
	help
	  This option signifies the use of an ARMv7-A processor
	  implementation supporting the ARM Memory Management Unit (MMU).

config ARMV7_EXCEPTION_STACK_SIZE
	int "Undefined Instruction and Abort stack size (in bytes)"
	default 256
	help
	  This option specifies the size of the stack used by the undefined
	  instruction and data abort exception handlers.

config ARMV7_FIQ_STACK_SIZE
	int "FIQ stack size (in bytes)"
	default 256
	help
	  This option specifies the size of the stack used by the FIQ handler.

config ARMV7_SVC_STACK_SIZE
	int "SVC stack size (in bytes)"
	default 512
	help
	  This option specifies the size of the stack used by the SVC handler.

config ARMV7_SYS_STACK_SIZE
	int "SYS stack size (in bytes)"
	default 1024
	help
	  This option specifies the size of the stack used by the system mode.

config RUNTIME_NMI
	default y

config GEN_ISR_TABLES
	default y

config GEN_IRQ_VECTOR_TABLE
	default n

endif # CPU_CORTEX_A

config CPU_CORTEX_R4
	bool
	select CPU_CORTEX_R
	select ARMV7_R
	select ARMV7_R_FP if CPU_HAS_FPU
	help
	  This option signifies the use of a Cortex-R4 CPU

config CPU_CORTEX_R5
	bool
	select CPU_CORTEX_R
	select ARMV7_R
	select ARMV7_R_FP if CPU_HAS_FPU
	help
	  This option signifies the use of a Cortex-R5 CPU

if CPU_CORTEX_R

config ARMV7_R
	bool
	select ATOMIC_OPERATIONS_BUILTIN
	select ISA_ARM
	select ISA_THUMB2
	help
	  This option signifies the use of an ARMv7-R processor
	  implementation.

	  From https://developer.arm.com/products/architecture/cpu-architecture/r-profile:
	  The Armv7-R architecture implements a traditional Arm architecture with
	  multiple modes and supports a Protected Memory System Architecture
	  (PMSA) based on a Memory Protection Unit (MPU). It supports the Arm (32)
	  and Thumb (T32) instruction sets.

config ARMV7_R_FP
	bool
	depends on ARMV7_R
	help
	  This option signifies the use of an ARMv7-R processor
	  implementation supporting the VFPv3-D16 Floating-Point Extension.

config ARMV7_EXCEPTION_STACK_SIZE
	int "Undefined Instruction and Abort stack size (in bytes)"
	default 256
	help
	  This option specifies the size of the stack used by the undefined
	  instruction and data abort exception handlers.

config ARMV7_FIQ_STACK_SIZE
	int "FIQ stack size (in bytes)"
	default 256
	help
	  This option specifies the size of the stack used by the FIQ handler.

config ARMV7_SVC_STACK_SIZE
	int "SVC stack size (in bytes)"
	default 512
	help
	  This option specifies the size of the stack used by the SVC handler.

config ARMV7_SYS_STACK_SIZE
	int "SYS stack size (in bytes)"
	default 1024
	help
	  This option specifies the size of the stack used by the system mode.

config RUNTIME_NMI
	default y

config GEN_ISR_TABLES
	default y

config GEN_IRQ_VECTOR_TABLE
	default n

endif # CPU_CORTEX_R

# Floating Point Unit configuration options
# Identical for VFPv3-D32 (Cortex-A) and VFPv3-D16 (Cortex-R, optional)

menu "VFPv3(-D32/-D16) Floating Point Unit options"
	depends on ARMV7_A_FP || ARMV7_R_FP

choice
	prompt "FPU Half-precision format"
	depends on ARMV7_A_FP || ARMV7_R_FP
	default ARMV7_FP_AHP_IEEE

config ARMV7_FP_AHP_IEEE
	bool "IEEE half-precision format"
	help
	  IEEE half-precision format.

config ARMV7_FP_AHP_ALT
	bool "Alternative half-precision"
	help
	  Alternative half-precision.

endchoice

choice
	prompt "FPU Default NaN mode (doesn't apply to advanced SIMD arithmetic)"
	depends on ARMV7_A_FP || ARMV7_R_FP
	default ARMV7_FP_NAN_PROPAGATE

config ARMV7_FP_NAN_PROPAGATE
	bool "Propagate NaN operands"
	help
	  Propagate NaN operands through to the output of a floating point operation.

config ARMV7_FP_NAN_RETURN_NAN
	bool "Return default NaN"
	help
	  Any operation involving one or more NaNs returns the default NaN.

endchoice

choice
	prompt "FPU Flush to zero mode (doesn't apply to advanced SIMD arithmetic)"
	depends on ARMV7_A_FP || ARMV7_R_FP
	default ARMV7_FP_FTZ_DISABLED

config ARMV7_FP_FTZ_DISABLED
	bool "Disabled, IEEE 754 compliant behavior"
	help
	  Flush to zero mode disabled. Behavior of the floating point system is
	  fully compliant with the IEEE 754 standard.

config ARMV7_FP_FTZ_FLUSH
	bool "Enabled"
	help
	  Flush to zero mode enabled.

endchoice

choice
	prompt "FPU Rounding mode (doesn't apply to advanced SIMD arithmetic)"
	depends on ARMV7_A_FP || ARMV7_R_FP
	default ARMV7_FP_ROUNDING_RN

config ARMV7_FP_ROUNDING_RN
	bool "Round to nearest"
	help
	  Round to nearest mode.

config ARMV7_FP_ROUNDING_RP
	bool "Round to plus infinity"
	help
	  Round to plus infinity mode.

config ARMV7_FP_ROUNDING_RM
	bool "Round to minus infinity"
	help
	  Round to minus infinity mode.

config ARMV7_FP_ROUNDING_RZ
	bool "Round to zero"
	help
	  Round to zero mode.

endchoice

endmenu
```

## boards/arm/qemu_cortex_a9/Kconfig.defconfig
```kconfig
#
# Kconfig - Cortex-A9 (Zynq-7000) QEMU Emulation
#
# Copyright (c) 2021, Weidmueller Interface GmbH & Co. KG
# SPDX-License-Identifier: Apache-2.0
#

if BOARD_QEMU_CORTEX_A9

config BUILD_OUTPUT_BIN
	default n

config BOARD
	default "qemu_cortex_a9"

config SYS_CLOCK_HW_CYCLES_PER_SEC
	int
	default 111111111

config SYS_CLOCK_TICKS_PER_SEC
	default 1000
	
if SERIAL

	config SERIAL_HAS_DRIVER
	default y

	config UART_INTERRUPT_DRIVEN
	default n

	config UART_XLNX_PS
	default y

endif # SERIAL

if CONSOLE

	config UART_CONSOLE
	default y

endif # CONSOLE

if NETWORKING

	config NET_L2_ETHERNET
	default y
	config NET_CONFIG_SETTINGS
	default y
	config NET_CONFIG_MY_IPV4_ADDR
	default "192.0.2.1"

	config NET_NATIVE
	default y
	config NET_IPV6
	default y
	config NET_IPV4
	default y
	config NET_TCP
	default y
	config NET_UDP
	default y

endif # NETWORKING

if UART_PIPE

	config UART_PIPE_ON_DEV_NAME
	default "uart1"

endif # UART_PIPE

endif # BOARD_QEMU_CORTEX_A9
```

## boards/arm/qemu_cortex_a9/qemu_cortex_a9_defconfig
```kconfig
#
# Copyright (c) 2021, Weidmueller Interface GmbH & Co. KG
#
# SPDX-License-Identifier: Apache-2.0
#

CONFIG_SOC_SERIES_XILINX_ZYNQ7000=y
CONFIG_SOC_XILINX_ZYNQ7000=y
CONFIG_BOARD_QEMU_CORTEX_A9=y
CONFIG_QEMU_ICOUNT=y
CONFIG_QEMU_ICOUNT_SHIFT=3

CONFIG_ARM_ARCH_TIMER=y

CONFIG_SERIAL=y
CONFIG_CONSOLE=y
CONFIG_NETWORKING=y
CONFIG_NET_QEMU_ETHERNET=y
CONFIG_GPIO=n

CONFIG_TEST_RANDOM_GENERATOR=y
CONFIG_SYSTEM_WORKQUEUE_STACK_SIZE=8192
CONFIG_NET_TX_STACK_SIZE=8192
CONFIG_NET_RX_STACK_SIZE=8192
```

## boards/arm/qemu_cortex_r5/Kconfig.defconfig
```kconfig
# Copyright (c) 2019 Lexmark International, Inc.
# SPDX-License-Identifier: Apache-2.0

if BOARD_QEMU_CORTEX_R5

config BUILD_OUTPUT_BIN
	default n

config BOARD
	default "qemu_cortex_r5"

if SERIAL

	config SERIAL_HAS_DRIVER
	default y

	config UART_INTERRUPT_DRIVEN
	default n

	config UART_XLNX_PS
	default y

endif # SERIAL

if CONSOLE

	config UART_CONSOLE
	default y

endif # CONSOLE

if NETWORKING

	config NET_L2_ETHERNET
	default y
	config NET_CONFIG_SETTINGS
	default y
	config NET_CONFIG_MY_IPV4_ADDR
	default "192.0.2.1"

	config ETH_XLNX_GEM
	default y

	config ETH_XLNX_GEM_PORT_0
	default y
	config ETH_XLNX_GEM_PORT_1
	default n
	config ETH_XLNX_GEM_PORT_2
	default n
	config ETH_XLNX_GEM_PORT_3
	default n

	config ETH_XLNX_GEM_PORT_0_INIT_PHY
	default y
	config ETH_XLNX_GEM_PORT_1_INIT_PHY
	default n
	config ETH_XLNX_GEM_PORT_2_INIT_PHY
	default n
	config ETH_XLNX_GEM_PORT_3_INIT_PHY
	default n

endif # NETWORKING

endif # BOARD_QEMU_CORTEX_R5
```

## boards/arm/qemu_cortex_r5/qemu_cortex_r5_defconfig
```kconfig
CONFIG_SOC_XILINX_ZYNQMP_RPU=y
CONFIG_BOARD_QEMU_CORTEX_R5=y
CONFIG_XIP=n
CONFIG_QEMU_ICOUNT_SHIFT=3

CONFIG_ISR_STACK_SIZE=512
CONFIG_THREAD_STACK_INFO=y

# Timer frequency adjustment (LSBUS clock)
CONFIG_SYS_CLOCK_HW_CYCLES_PER_SEC=150000000
CONFIG_SYS_CLOCK_TICKS_PER_SEC=1000

# enable uart driver
CONFIG_SERIAL=y

# enable console
CONFIG_CONSOLE=y

#enable networking
CONFIG_NETWORKING=y

CONFIG_TEST_RANDOM_GENERATOR=y
```

## boards/arm/zcu102/Kconfig.board
```kconfig
#
# Kconfig - Xilinx ZCU102 UltraScale Eval board
#
# Copyright (c) 2020, Weidmueller Interface GmbH & Co. KG
#
# SPDX-License-Identifier: Apache-2.0
#

config BOARD_ZCU102
    bool "Xilinx ZCU102"
    depends on SOC_XILINX_ZYNQMP_RPU
```

## boards/arm/zcu102/Kconfig.defconfig
```kconfig
#
# Kconfig - Xilinx ZCU102 UltraScale Eval board
#
# Copyright (c) 2020, Weidmueller Interface GmbH & Co. KG
#
# SPDX-License-Identifier: Apache-2.0
#

if BOARD_ZCU102

config BOARD
	default "zcu102"

config SYS_CLOCK_HW_CYCLES_PER_SEC
	int
	default 100000000

config SYS_CLOCK_TICKS_PER_SEC
	default 1000

if SERIAL

	config SERIAL_HAS_DRIVER
	default y

	config UART_INTERRUPT_DRIVEN
	default n

	config UART_XLNX_PS
	default y

endif # SERIAL

if CONSOLE

	config UART_CONSOLE
	default y

endif # CONSOLE

if NETWORKING

	config NET_L2_ETHERNET
	default y

	config ETH_XLNX_GEM
	default y

	config ETH_XLNX_GEM_PORT_0
	default n
	config ETH_XLNX_GEM_PORT_1
	default n
	config ETH_XLNX_GEM_PORT_2
	default n
	config ETH_XLNX_GEM_PORT_3
	default y

	config ETH_XLNX_GEM_PORT_0_INIT_PHY
	default n
	config ETH_XLNX_GEM_PORT_1_INIT_PHY
	default n
	config ETH_XLNX_GEM_PORT_2_INIT_PHY
	default n
	config ETH_XLNX_GEM_PORT_3_INIT_PHY
	default n

endif # NETWORKING

endif # BOARD_ZCU102
```

## boards/arm/zcu102/zcu102_defconfig
```kconfig
#
# Default configuration - Xilinx ZCU102 UltraScale Eval board
#
# Copyright (c) 2020, Weidmueller Interface GmbH & Co. KG
#
# SPDX-License-Identifier: Apache-2.0
#

CONFIG_SOC_XILINX_ZYNQMP_RPU=y
CONFIG_BOARD_ZCU102=y

CONFIG_XLNX_PSTTC_TIMER=y

CONFIG_SERIAL=y
CONFIG_CONSOLE=y

CONFIG_NETWORKING=y

CONFIG_GPIO=n

CONFIG_TEST_RANDOM_GENERATOR=y
CONFIG_XIP=n
```

## boards/arm/zedboard/Kconfig.defconfig
```kconfig
#
# Kconfig - AVNET/Digilent Zedboard
#
# Copyright (c) 2020, Weidmueller Interface GmbH & Co. KG
#
# SPDX-License-Identifier: Apache-2.0
#

if BOARD_ZEDBOARD

config BOARD
	default "zedboard"

config SYS_CLOCK_HW_CYCLES_PER_SEC
	int
	default 333333333

config SYS_CLOCK_TICKS_PER_SEC
	default 1000

if SERIAL

	config SERIAL_HAS_DRIVER
	default y

	config UART_INTERRUPT_DRIVEN
	default n

	config UART_XLNX_PS
	default y

endif # SERIAL

if CONSOLE

	config UART_CONSOLE
	default y

endif # CONSOLE

if NETWORKING

	config NET_L2_ETHERNET
	default y

	config ETH_XLNX_GEM
	default y

	config ETH_XLNX_GEM_PORT_0
	default y
	config ETH_XLNX_GEM_PORT_1
	default n

	config ETH_XLNX_GEM_PORT_0_INIT_PHY
	default y
	config ETH_XLNX_GEM_PORT_1_INIT_PHY
	default n

	config ETH_XLNX_GEM_PORT_0_DMA_BASE_ADDRESS
	default 0x00001000
	config ETH_XLNX_GEM_PORT_1_DMA_BASE_ADDRESS
	default 0x00021000

	config NET_NATIVE
	default y
	config NET_IPV6
	default y
	config NET_IPV4
	default y
	config NET_TCP
	default y
	config NET_UDP
	default y

endif # NETWORKING

#if GPIO

	config GPIO_XLNX_AXI
	default y

#endif # GPIO

endif # BOARD_ZEDBOARD
```

## boards/arm/zedboard/zedboard_defconfig
```kconfig
#
# Copyright (c) 2019, Weidmueller Interface GmbH & Co. KG
#
# SPDX-License-Identifier: Apache-2.0
#

CONFIG_SOC_XILINX_ZYNQ7000=y
CONFIG_BOARD_ZEDBOARD=y

CONFIG_ARM_ARCH_TIMER=y

CONFIG_FPU=y
CONFIG_FPU_SHARING=y
CONFIG_FP_SOFTABI=y

CONFIG_SERIAL=y
CONFIG_CONSOLE=y
CONFIG_NETWORKING=y
CONFIG_GPIO=y

CONFIG_TEST_RANDOM_GENERATOR=y
CONFIG_SYSTEM_WORKQUEUE_STACK_SIZE=8192
CONFIG_NET_TX_STACK_SIZE=8192
CONFIG_NET_RX_STACK_SIZE=8192
```

## drivers/can/Kconfig.xlnx
```kconfig
#
# Xilinx Processor System CAN controller driver
# configuration options
#
# Copyright (c) 2021, Weidmueller Interface GmbH & Co. KG
# SPDX-License-Identifier: Apache-2.0
#

menuconfig CAN_XLNX
	bool "Xilinx CAN controller driver"
	depends on SOC_XILINX_ZYNQMP_RPU \
	|| SOC_XILINX_ZYNQMP_APU \
	|| SOC_XILINX_ZYNQ7000
	help
	  Enable Xilinx Zynq-7000 / ZynqMP CAN controller driver.
```

## dts/bindings/can/xlnx,can.yaml
```yaml
# Copyright (c) 2020 Weidmueller Interface GmbH & Co. KG
# SPDX-License-Identifier: Apache-2.0

description: Xilinx Zynq-7000/ZynqMP CAN controller

compatible: "xlnx,can"

include: can-controller.yaml

properties:
    reg:
      required: true

    interrupts:
      required: true

    clocks:
      required: true
```
